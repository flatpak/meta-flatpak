## conf/distro/include/flatpak-applications.inc
```bitbake
# Enable flatpak application support.
#
# Include this file into your local.conf or into a profile-specific distro
# config file if you want to add support for flatpak-based applications in
# your images.

# Enable flatpak and its dependencies.
DISTRO_FEATURES_append = " pam usrmerge systemd flatpak"

# Enable user D-Bus session bus.
PACKAGECONFIG_append_pn-dbus = " user-session"

# This could/should be in our distro.conf... 2.4.x is GPLv3.
PREFERRED_VERSION_gnupg = "1.%"

# Disable sysvinit completely.
VIRTUAL-RUNTIME_init_manager = "systemd"
DISTRO_FEATURES_BACKFILL_CONSIDERED = "sysvinit"
VIRTUAL-RUNTIME_initscripts = ""
```

## conf/distro/include/ostree.inc
```bitbake
# Enable OSTree support.
DISTRO_FEATURES_append = " usrmerge systemd ostree"

# This could/should be in our distro.conf... 2.4.x is GPLv3.
PREFERRED_VERSION_gnupg = "1.%"

# Disable sysvinit completely.
VIRTUAL-RUNTIME_init_manager = "systemd"
DISTRO_FEATURES_BACKFILL_CONSIDERED = "sysvinit"
VIRTUAL-RUNTIME_initscripts = ""
```

## conf/distro/include/qemu-vga-console.inc
```bitbake
# Enable SDL VGA console emulation for qemu.
PACKAGECONFIG_append_pn-qemu-native = " sdl"
PACKAGECONFIG_append_pn-nativesdk-qemu = " sdl"
```

## conf/distro/os3.conf
```bitbake
require conf/distro/poky.conf

DISTRO = "os3"
DISTRO_NAME = "Flatpak Test Distro"
DISTRO_VERSION = "1.0"

# Flatpak assumes merged /usr.
DISTRO_FEATURES_append = " usrmerge"

# Usrmerge breaks gobject introspection data generation, so disable it for now.
DISTRO_FEATURES_BACKFILL_CONSIDERED += "gobject-introspection-data"

# Flatpak/OSTree requires systemd.
DISTRO_FEATURES_append = " systemd"
DISTRO_FEATURES_BACKFILL_CONSIDERED += "sysvinit"
VIRTUAL-RUNTIME_init_manager = "systemd"
VIRTUAL-RUNTIME_initscripts = ""

# Flatpak requires a user session (systemd --user + session bus).
DISTRO_FEATURES_append = " pam"
PACKAGECONFIG_append_pn-dbus = " user-session"
```

## conf/layer.conf
```bitbake
BBPATH .= ":${LAYERDIR}"

BBFILES += "${LAYERDIR}/recipes-*/*/*.bb \
            ${LAYERDIR}/recipes-*/*/*.bbappend"

BBFILE_COLLECTIONS += "flatpak"
BBFILE_PATTERN_flatpak := "^${LAYERDIR}/"
BBFILE_PRIORITY_flatpak = "5"

# Set a variable for easy access to the top directory of the flatpak layer.
FLATPAKBASE = '${@os.path.normpath("${LAYERDIR}/../meta-flatpak")}'

SUPPORTED_RECIPES_append = " \
    ${FLATPAKBASE}/conf/flatpak-supported-recipes.txt \
    ${FLATPAKBASE}/conf/depends-supported-recipes.txt \
"

# Pick up our passwd and group fragments for remotes if we have any
# pre-declared ones.
USERADD_UID_TABLES += "${@ d.getVar('TOPDIR', False) + '/conf/flatpak-passwd' \
                             if d.getVar('FLATPAK_APP_REPOS', False) else ''}"
USERADD_GID_TABLES += "${@ d.getVar('TOPDIR', False) + '/conf/flatpak-group' \
                             if d.getVar('FLATPAK_APP_REPOS', False) else ''}"

# Hmm... this does not seem to have the desired effect reliably from here.
# This should be in our distro.conf... 2.4.x is GPLv3.
#PREFERRED_VERSION_gnupg = "1.%"
#PREFERRED_VERSION_gnupg = "${@bb.utils.contains('DISTRO_FEATURES', 'flatpak', \
#                                                '1.%', '%', d)}"
```
